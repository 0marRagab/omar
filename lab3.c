#include "io.h"
void portf_init()
{
	SYSCTL_RCGCGPIO_R |= 0X20;
	while (SYSCTL_PRGPIO_R &= 0X20 ==0);
	GPIO_PORTF_LOCK_R=0X4C4F434B;
	GPIO_PORTF_CR_R |=0X1F;
	GPIO_PORTF_AMSEL_R&= ~0X1F;
	GPIO_PORTF_PCTL_R&= ~0XFFFFF;
	GPIO_PORTF_AFSEL_R&= ~0X1F;
	GPIO_PORTF_DEN_R|=0X1F;
	GPIO_PORTF_DIR_R|=0XE;
	GPIO_PORTF_PUR_R&=0X11;
	GPIO_PORTF_PUR_R|=0X11;
	GPIO_PORTF_DATA_R&=0X11;
	GPIO_PORTF_DATA_R|=0X11;
}
unsigned char SW1_INPUT()
{
	return 	GPIO_PORTF_DATA_R&0X10;
}
unsigned char SW2_INPUT()
{
	return 	GPIO_PORTF_DATA_R&0X1;
}
int main()
{
	portf_init();
	while(1)
	{
	unsigned char SW1_STATE=SW1_INPUT();
	unsigned char SW2_STATE=SW2_INPUT();
	while (SW1_STATE ==0X10 & SW2_STATE==0X01)
	{
	 SW1_STATE=SW1_INPUT();
	 SW2_STATE=SW2_INPUT();
	 GPIO_PORTF_DATA_R&= ~0XE;
	}
	if (SW1_STATE ==0X00 & SW2_STATE==0X00)
	{
		GPIO_PORTF_DATA_R&=~0X0E;
		GPIO_PORTF_DATA_R|=0X2;
	}
	else if(SW1_STATE ==0X00 & SW2_STATE==0X01)
		{
		GPIO_PORTF_DATA_R&=~0X0E;
		GPIO_PORTF_DATA_R|=0X4;
	  }
	else (SW1_STATE ==0X01 & SW2_STATE==0X00)
		{
		GPIO_PORTF_DATA_R&=~0X0E;
		GPIO_PORTF_DATA_R|=0X8;
	  }
	}
}